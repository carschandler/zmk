## app/config/boards/shields/CorneHS/Kconfig.defconfig
```kconfig
if SHIELD_CORNE_HS_LEFT

config ZMK_KEYBOARD_NAME
    default "Corne HS"

config ZMK_SPLIT_ROLE_CENTRAL
    default y

endif

if SHIELD_CORNE_HS_LEFT || SHIELD_CORNE_HS_RIGHT

config ZMK_SPLIT
    default y

endif
```

## app/config/boards/shields/CorneHS/Kconfig.shield
```kconfig
config SHIELD_CORNE_HS_LEFT
    def_bool $(shields_list_contains,corne_hs_left)

config SHIELD_CORNE_HS_RIGHT
    def_bool $(shields_list_contains,corne_hs_right)
```
